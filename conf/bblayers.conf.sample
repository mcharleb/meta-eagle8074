## conf/bblayers.conf.sample
```bitbake
# LAYER_CONF_VERSION is increased each time build/conf/bblayers.conf
# changes incompatibly
LCONF_VERSION = "6"

# FIXME Excelsior uses SOURCE, Eagle uses WORKSPACE, these need to be unified
export SOURCE := "${@os.path.abspath(os.path.join(os.path.dirname(bb.data.getVar('FILE', d)),'../..'))}"
export WORKSPACE := "${SOURCE}"

BBPATH = "${TOPDIR}"
BBFILES ?= ""

BBLAYERS ?= " \
  ${TOPDIR}/../poky/meta \
  ${TOPDIR}/../poky/meta-yocto \
  ${TOPDIR}/../poky/meta-openembedded/meta-oe \
  ${TOPDIR}/../poky/meta-openembedded/meta-python \
  ${TOPDIR}/../poky/meta-openembedded/meta-networking \
  ${TOPDIR}/../poky/meta-eagle8074 \
  ${TOPDIR}/../poky/meta-qti \
  ${TOPDIR}/../poky/meta-ros \
  ${TOPDIR}/../poky/meta-ros-eagle \
  ${TOPDIR}/../poky/meta-smartphone/meta-android \
  "
BBLAYERS_NON_REMOVABLE ?= " \
  ${TOPDIR}/../poky/meta \
  ${TOPDIR}/../poky/meta-yocto \
  "
```

## conf/distro/eagle8074.conf
```bitbake
DISTRO = "eagle8074"
DISTRO_NAME = "Eagle"
DISTRO_VERSION = "1.0"

DISTRO_FEATURES ?= "${DISTRO_FEATURES_LIBC} argp bluetooth ext2 largefile usbgadget usbhost wifi xattr 3g"

GCCVERSION = "6.2%"
```

## conf/layer.conf
```bitbake
# We have a conf and classes directory, add to BBPATH
BBPATH .= ":${LAYERDIR}"

# We have a recipes-* directories, add to BBFILES
BBFILES += "${LAYERDIR}/recipes-*/*/*.bb \
	${LAYERDIR}/recipes-*/*/*.bbappend"

BBFILE_COLLECTIONS += "eagle8074"
BBFILE_PATTERN_eagle8074 = "^${LAYERDIR}/"
BBFILE_PRIORITY_eagle8074 = "6"
```

## conf/machine/eagle8074.conf
```bitbake
#@TYPE: Machine
##@NAME: eagle8074
##@DESCRIPTION: Machine configuration for APQ8074 based qcom-bsp systems
MACHINE_EXTRA_RRECOMMENDS = " kernel-modules kernel-devicetree"
require conf/machine/include/arm/arch-armv7a.inc
IMAGE_FSTYPES += "tar.bz2 ext4"
EXTRA_IMAGECMD_ext4 ?= "-i 4096 -b 4096"
IMAGE_ROOTFS_SIZE ?= "16384"
PREFERRED_PROVIDER_virtual/kernel = "linux-qr-eagle8074"
SERIAL_CONSOLE ?= "115200 ttyHSL0"
KERNEL_IMAGETYPE ?= "Image.gz-dtb"
KERNEL_DEVICETREE ?= ""
KERNEL_BASE ?= "0x80000000"
KERNEL_CMDLINE ?= "console=ttyHSL0,115200,n8 androidboot.console=ttyHSL0 androidboot.hardware=qcom user_debug=31 msm_rtb.filter=0x237 ehci-hcd.park=3 lpm_levels.sleep_disabled=1 cma=16M@0-0xffffffff root=/dev/sde18"
USE_VT = "0"
```
